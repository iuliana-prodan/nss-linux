## drivers/nss/Kconfig
```kconfig
# SPDX-License-Identifier: GPL-2.0-only

menuconfig NSS_DRIVERS
	bool "NXP summer school drivers"
	default n
	help
	  Enable support for NXP Summer School drivers.

if NSS_DRIVERS

config NSS_DRIVERS_LAB02
	bool "NXP summer school lab 02 drivers"
	default n
	help
	  Enable support for lab 02 drivers.

source "drivers/nss/lab02/Kconfig"

endif # NSS_DRIVERS
```

## drivers/nss/lab01/Kconfig
```kconfig
# SPDX-License-Identifier: GPL-2.0-only

if NSS_DRIVERS_LAB01

config NSS_DRIVERS_LAB01_EX01
	tristate "Exercise 01 - Linux kernel module"
	default n
	help
	  Exercise 01 - Linux kernel module sample.

config NSS_DRIVERS_LAB01_EX04
	tristate "Exercise 04 - Linux kernel module with parameter"
	default n
	help
	  Exercise 04 - Linux kernel module with parameter.

config NSS_DRIVERS_LAB01_EX05
	tristate "Exercise 05 - Character device driver"
	default n
	help
	  Exercise 04 - Character device driver sample.

endif # NSS_DRIVERS_LAB01
```

## drivers/nss/lab02/Kconfig
```kconfig
# SPDX-License-Identifier: GPL-2.0-only

if NSS_DRIVERS_LAB02

config NSS_DRIVERS_LAB02_EX02
	tristate "Exercise 02 - platform drivers warm-up"
	default n
	help
	  Exercise 02 - platform drivers warm-up.

config NSS_DRIVERS_LAB02_EX03
	tristate "Exercise 03 - LED warm-up"
	default n
	help
	  Exercise 03 - GPIO warm-up.

config NSS_DRIVERS_LAB02_EX04
	tristate "Exercise 04 - LED math"
	default n
	help
	  Exercise 04 - LED math.

endif # NSS_DRIVERS_LAB02
```
